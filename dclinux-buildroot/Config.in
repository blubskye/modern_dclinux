## dclinux-buildroot/configs/dreamcast_defconfig
```kconfig
# Architecture - SuperH
BR2_sh=y

# Global patch directory for kernel patches
BR2_GLOBAL_PATCH_DIR="$(BR2_EXTERNAL_DCLINUX_PATH)/patches"

# System configuration
BR2_TARGET_GENERIC_HOSTNAME="dreamcast"
BR2_TARGET_GENERIC_ISSUE="Dreamcast Linux (Buildroot)"
BR2_TARGET_GENERIC_GETTY_PORT="ttySC1"
BR2_SYSTEM_DHCP="eth0"

# Toolchain - Use headers matching kernel version
BR2_PACKAGE_HOST_LINUX_HEADERS_CUSTOM_4_19=y
BR2_TOOLCHAIN_BUILDROOT_GLIBC=y
BR2_TOOLCHAIN_BUILDROOT_CXX=y

# Kernel - Conservative 4.19 LTS
BR2_LINUX_KERNEL=y
BR2_LINUX_KERNEL_CUSTOM_VERSION=y
BR2_LINUX_KERNEL_CUSTOM_VERSION_VALUE="4.19.316"
BR2_LINUX_KERNEL_USE_CUSTOM_CONFIG=y
BR2_LINUX_KERNEL_CUSTOM_CONFIG_FILE="$(BR2_EXTERNAL_DCLINUX_PATH)/board/dreamcast/linux.config"
BR2_LINUX_KERNEL_VMLINUX=y

# Filesystem
BR2_TARGET_ROOTFS_EXT2=y
BR2_TARGET_ROOTFS_EXT2_4=y
BR2_TARGET_ROOTFS_EXT2_SIZE="450M"
# BR2_TARGET_ROOTFS_TAR is not set

# Overlay and scripts
BR2_ROOTFS_OVERLAY="$(BR2_EXTERNAL_DCLINUX_PATH)/board/dreamcast/overlay"
BR2_ROOTFS_POST_BUILD_SCRIPT="$(BR2_EXTERNAL_DCLINUX_PATH)/board/dreamcast/post-build.sh"
BR2_ROOTFS_POST_IMAGE_SCRIPT="$(BR2_EXTERNAL_DCLINUX_PATH)/board/dreamcast/post-image.sh"

# Core utilities - Full GNU tools
BR2_PACKAGE_BASH=y
BR2_PACKAGE_COREUTILS=y
BR2_PACKAGE_UTIL_LINUX=y

# Text editors
BR2_PACKAGE_NANO=y
BR2_PACKAGE_VIM=y

# Network packages
BR2_PACKAGE_DHCPCD=y
BR2_PACKAGE_DROPBEAR=y
BR2_PACKAGE_NFS_UTILS=y
```
